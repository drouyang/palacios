## palacios/src/interfaces/Kconfig
```kconfig
menu "Host Interfaces"

config FILE
        bool "Host Support for file operations"
        default y
        help
          Select this if your host OS supports file operatoins and you want Palacios to be able to use them.
	

config STREAM
	bool "Stream support"
	default n

          
config CONSOLE
	bool "Host Support for VM text-mode console"
        default y
        help
          Select this if you want to forward a guest console interface to some host OS service
          This is for a TEXT MODE console.   Select the framebuffer console for graphics and text
            
config GRAPHICS_CONSOLE
        bool "Host Support for VM graphics and text-mode console based on a frame buffer"
        default n
	help
          Select this if you want to forward a guest graphics-mode (and text-mode) console
          interface to some host OS service.  This is for a GRAPHICS console based on a shared frame buffer.
          Text mode output is RENDERED onto the framebuffer

config SOCKET
        bool "Host support for Network Sockets"
        default y
        help
          Select this if you host OS implements a socket API that is available to Palacios. This is required
          to support the internal networking features of Palacios.


config PACKET
        bool "Host support for Raw Packet Transmision"
        depends on EXPERIMENTAL
        default n
        help
      	  Select this if you host OS implements a raw packet network API that is available to Palacios. This is required
          to support the internal networking features of Palacios.


config HOST_PCI
	bool "Host PCI Support"
	default y
	help 
	  This enables host support for passthrough PCI devices

config HOST_SCHED_EVENTS
	bool "Host Scheduler Events support"
	default y
	help
	   This provides notifications for host scheduler events

config HOST_XPMEM
	bool "Host XPMEM Support"
	depends on EXPERIMENTAL
	default y
	help 
	  This enables host support for XPMEM PCI devices

config HOST_XPMEM_KERN_PATH
	depends on HOST_XPMEM && LINUX
	string "XPMEM Linux source tree"
	default "/path/to/xpmem"
	help
	    This is the directory containing the XPMEM source code

endmenu
```
